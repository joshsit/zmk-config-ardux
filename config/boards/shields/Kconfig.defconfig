## config/boards/shields/Kconfig.defconfig
```kconfig
if SHIELD_THE_PAINTBRUSH

config ZMK_KEYBOARD_NAME    
    default "the_paintbrush"

endif
```

## config/boards/shields/the_paintbrush/Kconfig.defconfig
```kconfig
if SHIELD_THE_PAINTBRUSH

config ZMK_KEYBOARD_NAME    
    default "Bar Soap"

endif
```
