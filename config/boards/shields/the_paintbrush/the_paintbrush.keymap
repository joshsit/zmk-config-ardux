/*
 * Copyright (c) 2020 The ZMK Contributors
 *
 * SPDX-License-Identifier: MIT
 */

#include <behaviors.dtsi>
#include <dt-bindings/zmk/keys.h>
#include <dt-bindings/zmk/bt.h>
// #include <dt-bindings/zmk/mouse.h>


#define ZMK_POINTING_DEFAULT_MOVE_VAL 1500  // default: 600
#define ZMK_POINTING_DEFAULT_SCRL_VAL 20    // default: 10

#include <dt-bindings/zmk/pointing.h>

// Enable ARDUX Left
#define ARDUX_LEFT 1
#define ARDUX_COLEMAK 1

// ARTS Row
#define KEY_A 3
#define KEY_R 2
#define KEY_T 1
#define KEY_S 0
// EYIO Row
#define KEY_E 7
#define KEY_Y 6
#define KEY_I 5
#define KEY_O 4

// Define Offsets
#define LEADING_NONES NONE(0,0,0)
#define MIDDLE_NONES NONE(0,0,0)
#define TRAILING_NONES NONE(0,0,0)

#if !defined ARDUX_BT_TOP
#define ARDUX_BT_TOP &bootloader
#endif
#if !defined ARDUX_BT_BOTTOM
#define ARDUX_BT_BOTTOM &bootloader
#endif





//&mmv {
//  acceleration-exponent = <2>;      // 1 
//  time-to-max-speed-ms = <1000>;    // 40
//  delay-ms = <0>;                   // 0
//};

//&msc {
//  acceleration-exponent = <0>;      // 0
//  time-to-max-speed-ms = <0>;    // 40
//  delay-ms = <0>;                   // 10
//};

//#define U_MOUSE_MOVE_MAX 1200   // 600
//#define U_MOUSE_SCROLL_MAX 10    // 10

//#undef MOVE_UP
//#undef MOVE_DOWN
//#undef MOVE_LEFT
//#undef MOVE_RIGHT
//#define MOVE_UP MOVE_Y(-U_MOUSE_MOVE_MAX)
//#define MOVE_DOWN MOVE_Y(U_MOUSE_MOVE_MAX)
//#define MOVE_LEFT MOVE_X(-U_MOUSE_MOVE_MAX)
//#define MOVE_RIGHT MOVE_X(U_MOUSE_MOVE_MAX)

//#undef SCROLL_UP
//#undef SCROLL_DOWN
//#undef SCROLL_LEFT
//#undef SCROLL_RIGHT
//#define SCROLL_UP SCRL_Y(U_MOUSE_SCROLL_MAX)
//#define SCROLL_DOWN SCRL_Y(-U_MOUSE_SCROLL_MAX)
//#define SCROLL_LEFT SCRL_X(-U_MOUSE_SCROLL_MAX)
//#define SCROLL_RIGHT SCRL_X(U_MOUSE_SCROLL_MAX)

//#define U_BTN1 &mkp MB1
//#define U_BTN2 &mkp MB2
//#define U_BTN3 &mkp MB3
//#define U_MS_U &mmv MOVE_UP
//#define U_MS_D &mmv MOVE_DOWN
//#define U_MS_L &mmv MOVE_LEFT
//#define U_MS_R &mmv MOVE_RIGHT
//#define U_WH_U &msc SCROLL_UP
//#define U_WH_D &msc SCROLL_DOWN
//#define U_WH_L &msc SCROLL_LEFT
//#define U_WH_R &msc SCROLL_RIGHT

// Include main ardux.io keymap
#include "../../../ardux.dtsi"